## sdkconfig.defaults
```kconfig
# ESP32-C3 Configuration
CONFIG_IDF_TARGET="esp32c3"

# Flash Configuration - ESP32-C3 typically has 4MB flash
CONFIG_ESPTOOLPY_FLASHSIZE_4MB=y
CONFIG_ESPTOOLPY_FLASHSIZE="4MB"
CONFIG_ESPTOOLPY_FLASHFREQ_80M=y
CONFIG_ESPTOOLPY_FLASHMODE_DIO=y

# Partition Table
CONFIG_PARTITION_TABLE_CUSTOM=y
CONFIG_PARTITION_TABLE_CUSTOM_FILENAME="partitions.csv"
CONFIG_PARTITION_TABLE_FILENAME="partitions.csv"

# Disable Anti-rollback for now (can enable later if needed)
CONFIG_BOOTLOADER_APP_ROLLBACK_ENABLE=n
CONFIG_BOOTLOADER_APP_ANTI_ROLLBACK=n

# ===== CRITICAL BLE CONFIGURATIONS =====
# These are missing from your original file and likely why BLE isn't working

# Bluetooth Controller Configuration
CONFIG_BT_ENABLED=y
CONFIG_BT_CONTROLLER_ENABLED=y
CONFIG_BT_CTRL_MODE_EFF=1
CONFIG_BT_CTRL_MODE_BLE_ONLY=y
CONFIG_BT_CONTROLLER_BLE_MAX_CONN=3
CONFIG_BT_CTRL_BLE_MAX_ACT=10
CONFIG_BT_CTRL_BLE_STATIC_ACL_TX_BUF_NB=0

# NimBLE Host Configuration
CONFIG_BT_NIMBLE_ENABLED=y
CONFIG_BT_NIMBLE_HOST_TASK_STACK_SIZE=5120
CONFIG_BT_NIMBLE_ROLE_CENTRAL=y
CONFIG_BT_NIMBLE_ROLE_PERIPHERAL=y
CONFIG_BT_NIMBLE_ROLE_BROADCASTER=y
CONFIG_BT_NIMBLE_ROLE_OBSERVER=y
CONFIG_BT_NIMBLE_MAX_CONNECTIONS=3
CONFIG_BT_NIMBLE_MEM_ALLOC_MODE_INTERNAL=y
CONFIG_BT_NIMBLE_PINNED_TO_CORE_0=y
CONFIG_BT_NIMBLE_PINNED_TO_CORE=0
CONFIG_BT_NIMBLE_NVS_PERSIST=y

# BLE Specific Settings
CONFIG_BT_NIMBLE_WHITELIST_SIZE=12
CONFIG_BT_NIMBLE_ACL_BUF_COUNT=20
CONFIG_BT_NIMBLE_HCI_EVT_BUF_SIZE=70
CONFIG_BT_NIMBLE_HCI_EVT_HI_BUF_COUNT=30
CONFIG_BT_NIMBLE_HCI_EVT_LO_BUF_COUNT=8

# GAP Settings
CONFIG_BT_NIMBLE_SVC_GAP_DEVICE_NAME="ESP32-C3-IMU"
CONFIG_BT_NIMBLE_SVC_GAP_APPEARANCE=0

# ATT Settings
CONFIG_BT_NIMBLE_ATT_PREFERRED_MTU=247

# Security (disabled for now)
CONFIG_BT_NIMBLE_SECURITY_ENABLE=n

# Optimization for size
CONFIG_COMPILER_OPTIMIZATION_SIZE=y

# Log level
CONFIG_LOG_DEFAULT_LEVEL_INFO=y
CONFIG_LOG_MAXIMUM_LEVEL_DEBUG=y

# FreeRTOS
CONFIG_FREERTOS_HZ=1000

# Enable GPIO ISR service
CONFIG_GPIO_ESP32_SUPPORT_SWITCH_SLP_PULL=y

# I2C
CONFIG_I2C_ENABLE_DEBUG_LOG=n
```
